## base_external/Config.in
```kconfig
source "$BR2_EXTERNAL_project_base_PATH/package/pcie_accel_emu/Config.in"
source "$BR2_EXTERNAL_project_base_PATH/package/libvai/Config.in"
```

## base_external/package/libvai/Config.in
```kconfig
config BR2_PACKAGE_LIBVAI
    bool "libvai"
    help
        Build the libvai library and example app (uses libvai) which communicates with the device via driver ioctl
```

## base_external/package/pcie_accel_emu/Config.in
```kconfig
config BR2_PACKAGE_PCIE_ACCEL_EMU
    bool "pcie_accel_emu"
    help
        Build the pcie_accel_emu kernel module to drive the virtual pciemu device for custom AI acceleration
```
